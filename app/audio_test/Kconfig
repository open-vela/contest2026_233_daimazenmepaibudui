## app/hello_app/Kconfig
```kconfig
config LVX_USE_CONTEST2026_233_HELLO_APP
	bool "AI Companion - 智爱陪伴AI老人陪伴守护终端"
	default n
	help
		Enable the AI companion app for elderly care.

if LVX_USE_CONTEST2026_233_HELLO_APP

config HELLO_APP_PROGNAME
	string "Program name"
	default "ai_companion"

config HELLO_APP_PRIORITY
	int "Task priority"
	default 100

config HELLO_APP_STACKSIZE
	int "Stack size"
	default 16384

choice
	prompt "Conversation backend"
	default HELLO_APP_LLM_AI_AGENT if EXAMPLES_AI_AGENT_VELA
	default HELLO_APP_LLM_MOCK

config HELLO_APP_LLM_AI_AGENT
	bool "openvela ai_agent (recommended for contest)"
	depends on EXAMPLES_AI_AGENT_VELA
	help
		Send requests to the on-device ai_agent local client. Configure MiMo
		at runtime with router_set; do not compile an API key into this app.

config HELLO_APP_LLM_MOCK
	bool "Offline mock (development only)"
	help
		Fixed local response for host tests. Not valid for the contest demo.

endchoice

config AI_LLM_API_KEY
	string "Legacy test API key"
	default ""
	depends on HELLO_APP_LLM_MOCK

config AI_LLM_MODEL
	string "LLM model name"
	default "mimo-v2.5"

config HELLO_APP_EDGE_IMPULSE
	bool "Enable Edge Impulse abnormal-sound model"
	default n
	help
		Use a 16 kHz mono model exported into model/edge_impulse.

config HELLO_APP_SOUND_EVENT
	bool "Enable local sound event recognition (mel + DSCNN-lite)"
	default y
	help
		Build app/hello_app/sound_event.c: an on-device, zero-dependency
		sound-event classifier (0=other 1=fall 2=knock 3=scream).
		mel front-end (own 512-point FFT) + DSCNN-lite forward + 3/4 window
		voting with per-class thresholds and an 8 s refractory period.
		Weights live in app/hello_app/sound_event_model.h (exported by
		tools/audio_event/export_c.py). Callers feed PCM through
		sound_event_feed() and hook sound_event_set_callback() to react.

config DEBUG_AI_COMPANION
	bool "Enable state machine debug output"
	default n

config DEBUG_AI_AUDIO
	bool "Enable audio debug output"
	default n

config DEBUG_AI_LLM
	bool "Enable LLM debug output"
	default n

config DEBUG_AI_SOUND_DETECT
	bool "Enable sound detection debug output"
	default n

config DEBUG_AI_CARE
	bool "Enable care debug output"
	default n

endif # LVX_USE_CONTEST2026_233_HELLO_APP
```
